/*
 * Copyright (c) 2019, The Linux Foundation. All rights reserved.
 *
 * This program is free software; you can redistribute it and/or modify
 * it under the terms of the GNU General Public License version 2 and
 * only version 2 as published by the Free Software Foundation.
 *
 * This program is distributed in the hope that it will be useful,
 * but WITHOUT ANY WARRANTY; without even the implied warranty of
 * MERCHANTABILITY or FITNESS FOR A PARTICULAR PURPOSE.  See the
 * GNU General Public License for more details.
 */

&mtp_batterydata {
	        qcom,batt-id-range-pct = <19>;
		#include "battery/oppo_battery_4910mah_68k_pmi632_atl.dtsi"
		#include "battery/oppo_battery_5000mah_470k_pmi632_sdi.dtsi"
		#include "battery/oppo_battery_5000mah_15k_pmi632_cl.dtsi"
};

&pmi632_qg {
	qcom,qg-iterm-ma = <320>;
	qcom,cl-feedback-on;
};

&pmi632_charger {
	qcom,chg-term-src = <1>;
	qcom,chg-term-current-ma = <(-250)>;
	qcom,chg-term-base-current-ma = <(-200)>;
    	qcom,flash-disable-soc = <1>;

	/delete-property/ qcom,hw-die-temp-mitigation;
	/delete-property/ qcom,hw-connector-mitigation;
        /delete-property/ qcom,connector-internal-pull-kohm;
};
